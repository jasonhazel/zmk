## app/boards/shields/dilly/Kconfig.defconfig
```kconfig
# Copyright (c) 2022 The ZMK Contributors
# SPDX-License-Identifier: MIT

if SHIELD_DILLY
config ZMK_KEYBOARD_NAME
    default "Dilly"
endif
```

## app/boards/shields/dilly/Kconfig.shield
```kconfig
# Copyright (c) 2022 The ZMK Contributors
# SPDX-License-Identifier: MIT

config SHIELD_DILLY
  def_bool $(shields_list_contains, dilly)
```
